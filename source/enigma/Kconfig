## source/enigma/Kconfig
```kconfig
menu "Enigma module"

config ENIGMAMODULE
        tristate "enigma module"
        default M
        help
                Select to enable enigma module.
endmenu
```

## source/openvision/Kconfig
```kconfig
menu "Open Vision module"

config OPENVISIONMODULE
        tristate "openvision module"
        default M
        help
                Select to enable openvision module.
endmenu
```
